# file: ProjetoCarregadorRuben.ioc
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Mcu.Family=STM32C0
Mcu.Name=STM32C031C(4-6)Tx
Mcu.Package=LQFP48
ProjectManager.HeapSize=0x200
ProjectManager.StackSize=0x400
ProjectManager.TargetToolchain=STM32CubeIDE
RCC.ADCFreq_Value=48000000
RCC.AHBFreq_Value=48000000
RCC.CortexFreq_Value=48000000
RCC.EXTERNAL_CLOCK_VALUE=12288000
RCC.HCLKFreq_Value=48000000
RCC.HSE_VALUE=8000000
RCC.HSISYSCLKDivider=RCC_HSI_DIV1
RCC.HSI_VALUE=48000000
RCC.LSE_VALUE=32768
RCC.SYSCLKFreq_VALUE=48000000
board=custom

// file: Core/Src/main.c
/* USER CODE BEGIN Header */
/**
 ******************************************************************************
 * @file           : main.c
 * @brief          : Main program body
 ******************************************************************************
 * @attention
 *
 * Copyright (c) 2024 STMicroelectronics.
 * All rights reserved.
 *
 * This software is licensed under terms that can be found in the LICENSE file
 * in the root directory of this software component.
 * If no LICENSE file comes with this software, it is provided AS-IS.
 *
 ******************************************************************************
 */
/* USER CODE END Header */
#include "main.h"

/* USER CODE BEGIN Includes */
#include "adcFile.h"
#include "pwm.h"
/* USER CODE END Includes */

/* USER CODE BEGIN PD */
#define FACTOR_VOLTAGE	0.00886	// It's the factor to convert AD measure in Voltage: 3.3*11/4096
#define INPUT_VOLTAGE	0
#define OUTPUT_VOLTAGE	4
#define BATTERY_VOLTAGE	1
#define MAXIMUM_PWM	400
#define LOW_VOLTAGE	5
#define HIGH_VOLTAGE 5.5
/* USER CODE END PD */

void SystemClock_Config(void);

int main(void)
{

	/* USER CODE BEGIN 1 */
	uint16_t pwmBoost = 0;
	uint16_t pwmBuck = MAXIMUM_PWM;
	uint8_t estado = 0;
	float voltage12V = 0;
	float voltage3dot7V = 0;
	float outputVoltage = 0;
	/* USER CODE END 1 */

	/* MCU Configuration--------------------------------------------------------*/

	/* Reset of all peripherals, Initializes the Flash interface and the Systick. */
	HAL_Init();

	/* USER CODE BEGIN Init */
	ConfigAdc();
	PwmConfig();
	/* USER CODE END Init */
	/* Configure the system clock */
	SystemClock_Config();

	/* Initialize all configured peripherals */

	/* Infinite loop */
	while (1)
	{
		voltage12V = ReadAdc(INPUT_VOLTAGE) * FACTOR_VOLTAGE;
		//voltage3dot7V = ReadAdc(BATTERY_VOLTAGE) * FACTOR_VOLTAGE - 0.6;

		switch(estado)
		{
		case 0:

			if(voltage12V < LOW_VOLTAGE)
			{
				estado = 1;
				TIM1->CCR2 = 0; //Boost
			}
			else if(voltage12V > HIGH_VOLTAGE)
			{
				estado = 2;
				TIM1->CCR1 = MAXIMUM_PWM;	//Buck
			}
			break;

		case 1:

			TIM1->CCR1 = 400;
			voltage3dot7V = ReadAdc(BATTERY_VOLTAGE) * FACTOR_VOLTAGE;
			if(voltage3dot7V > 3.2)
			{
				outputVoltage = ReadAdc(OUTPUT_VOLTAGE) * FACTOR_VOLTAGE;
				if((outputVoltage < 5) && pwmBoost < 100)
				{
					pwmBoost++;
				}
				else if((outputVoltage > 5) && pwmBoost > 0)
				{
					pwmBoost--;
				}
				TIM1->CCR2 = pwmBoost;
			}
			else
			{
				TIM1->CCR2 = 0;
			}

			if(voltage12V > HIGH_VOLTAGE)
			{
				estado = 2;
				TIM1->CCR2 = 0;
			}

			break;

		case 2:

			TIM1->CCR2 = 0;
			outputVoltage = ReadAdc(OUTPUT_VOLTAGE) * FACTOR_VOLTAGE;
			if((outputVoltage > 5) && pwmBuck > 0)
			{
				pwmBuck--;
			}
			else if((outputVoltage < 5) && pwmBuck < 100)
			{
				pwmBuck++;
			}
			TIM1->CCR1 = pwmBuck;
			if(voltage12V < LOW_VOLTAGE)
			{
				estado = 1;
				TIM1->CCR1 = MAXIMUM_PWM;
			}
			break;
		}
	}
}

void SystemClock_Config(void)
{
	RCC_OscInitTypeDef RCC_OscInitStruct = {0};
	RCC_ClkInitTypeDef RCC_ClkInitStruct = {0};

	/** Initializes the RCC Oscillators according to the specified parameters
	 * in the RCC_OscInitTypeDef structure.
	 */
	RCC_OscInitStruct.OscillatorType = RCC_OSCILLATORTYPE_HSI;
	RCC_OscInitStruct.HSIState = RCC_HSI_ON;
	RCC_OscInitStruct.HSIDiv = RCC_HSI_DIV1;
	RCC_OscInitStruct.HSICalibrationValue = RCC_HSICALIBRATION_DEFAULT;
	if (HAL_RCC_OscConfig(&RCC_OscInitStruct) != HAL_OK)
	{
		Error_Handler();
	}

	/** Initializes the CPU, AHB and APB buses clocks
	 */
	RCC_ClkInitStruct.ClockType = RCC_CLOCKTYPE_HCLK|RCC_CLOCKTYPE_SYSCLK
			|RCC_CLOCKTYPE_PCLK1;
	RCC_ClkInitStruct.SYSCLKSource = RCC_SYSCLKSOURCE_HSI;
	RCC_ClkInitStruct.SYSCLKDivider = RCC_SYSCLK_DIV1;
	RCC_ClkInitStruct.AHBCLKDivider = RCC_HCLK_DIV1;
	RCC_ClkInitStruct.APB1CLKDivider = RCC_APB1_DIV1;

	if (HAL_RCC_ClockConfig(&RCC_ClkInitStruct, FLASH_LATENCY_1) != HAL_OK)
	{
		Error_Handler();
	}
}

void Error_Handler(void)
{
	__disable_irq();
	while (1)
	{
	}
}
